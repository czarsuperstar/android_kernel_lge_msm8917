/* Copyright (c) 2013, The Linux Foundation. All rights reserved.
 *
 * This program is free software; you can redistribute it and/or modify
 * it under the terms of the GNU General Public License version 2 and
 * only version 2 as published by the Free Software Foundation.
 *
 * This program is distributed in the hope that it will be useful,
 * but WITHOUT ANY WARRANTY; without even the implied warranty of
 * MERCHANTABILITY or FITNESS FOR A PARTICULAR PURPOSE.  See the
 * GNU General Public License for more details.
 */

/*---------------------------------------------------------------------------
 * This file is autogenerated file using gcdb parser. Please do not edit it.
 * Update input XML file to add a new entry or update variable in this file
 * VERSION = "1.0"
 *---------------------------------------------------------------------------*/
&mdss_mdp {
	dsi_lv5_lgd_lg4894_hd_video: qcom,mdss_dsi_lv5_lgd_lg4894_hd_video {
		compatible = "qcom,mdss-dsi-panel";
		status = "ok";
		qcom,cont-splash-enabled;
		qcom,mdss-dsi-panel-name = "LGD LG4894 HD video mode dsi panel";
		qcom,mdss-dsi-panel-controller = <&mdss_dsi0>;
		qcom,mdss-dsi-panel-type = "dsi_video_mode";
		qcom,mdss-dsi-panel-destination = "display_1";
		qcom,mdss-dsi-force-clock-lane-hs;
		qcom,mdss-dsi-panel-framerate = <60>;
		qcom,mdss-dsi-virtual-channel-id = <0>;
		qcom,mdss-dsi-stream = <0>;
		qcom,mdss-dsi-lp11-init;
		qcom,suspend-ulps-enabled;
		//qcom,esd-check-enabled;
		//qcom,mdss-dsi-panel-status-check-mode = "reg_read";
		//qcom,mdss-dsi-panel-status-read-length = <1>;
		//qcom,mdss-dsi-panel-status-value = <0x00>;
		qcom,mdss-dsi-tx-eot-append;
		qcom,mdss-dsi-panel-width = <720>;
		qcom,mdss-dsi-panel-height = <1280>;
		qcom,mdss-dsi-h-front-porch = <12>;
		qcom,mdss-dsi-h-back-porch = <36>;
		qcom,mdss-dsi-h-pulse-width = <4>;
		qcom,mdss-dsi-h-sync-skew = <0>;
		qcom,mdss-dsi-v-back-porch = <15>;
		qcom,mdss-dsi-v-front-porch = <500>;
		qcom,mdss-dsi-v-pulse-width = <1>;
		qcom,mdss-dsi-h-left-border = <0>;
		qcom,mdss-dsi-h-right-border = <0>;
		qcom,mdss-dsi-v-top-border = <0>;
		qcom,mdss-dsi-v-bottom-border = <0>;
		qcom,mdss-pan-physical-width-dimension = < 66 >; // 65.98mm
		qcom,mdss-pan-physical-height-dimension = < 117 >; // 117.31 mm
		qcom,mdss-dsi-bpp = <24>;
		qcom,mdss-dsi-color-order = "rgb_swap_rgb";
		qcom,mdss-dsi-underflow-color = <0xff>;
		qcom,mdss-dsi-border-color = <0>;
		qcom,mdss-dsi-on-command = [
			/* Manufacturer Command Protection */
			15 01 00 00 00 00 02 B0 AC
			/* Display Control 1 */
			39 01 00 00 00 00 05 B1 10 30 16 00
			/* Display Control 2 */
			39 01 00 00 00 00 0D B2 01 00 21 20 58 00 CF 10 1F 1F 34 34
			/* Panel Setting */
			39 01 00 00 00 00 04 B4 00 9F 00
			/* MIPI DSI Configuration */
			39 01 00 00 00 00 06 B5 42 C0 80 00 00
			/* MIPI D-PHY Configuration */
			39 01 00 00 00 00 04 B6 77 34 48
			/* Touch Control */
			39 01 00 00 00 00 0A BD D0 02 F4 01 04 04 12 20 22
			/* LFD Control */
			39 01 00 00 00 00 08 BE E0 E0 C9 C9 C8 F8 00
			/* Power Control 1 */
			39 01 00 00 00 00 07 C1 01 E8 D8 C2 C1 00
			/* Power Control 2 */
			39 01 00 00 00 00 04 C2 3B 13 13
			/* Power Control 3 */
			39 01 00 00 00 00 07 C3 15 2F 2F 00 66 21
			/* Power Control 4 */
			39 01 00 00 00 00 04 C4 51 00 37
			/* Power Control 5 */
			39 01 00 00 00 00 06 C5 25 20 20 14 14
			/* Temp Control */
			39 01 00 00 00 00 0D C7 10 22 00 28 00 62 62 62 00 B1 01 00
			/* Power Sequence Option Configuration */
			39 01 00 00 00 00 05 C8 01 00 03 8C
			/* Power Control for Touch */
			39 01 00 00 00 00 0F CC 22 2F 11 26 21 24 02 62 62 62 00 B1 01 00
			/* Positive Gamma Curve for Red */
			39 01 00 00 00 00 0D D0 10 67 43 43 32 51 00 00 00 42 46 03
			/* Negative Gamma Curve for Red */
			39 01 00 00 00 00 0D D1 10 67 43 43 32 51 00 00 00 42 46 03
			/* Positive Gamma Curve for Green */
			39 01 00 00 00 00 0D D2 10 67 43 43 32 51 00 00 00 42 46 03
			/* Negative Gamma Curve for Green */
			39 01 00 00 00 00 0D D3 10 67 43 43 32 51 00 00 00 42 46 03
			/* Positive Gamma Curve for Blue */
			39 01 00 00 00 00 0D D4 10 67 43 43 32 70 0F 0F 00 21 46 03
			/* Negative Gamma Curve for Blue */
			39 01 00 00 00 00 0D D5 10 67 43 43 32 70 0F 0F 00 21 46 03
			/* GIP Pad Setting 1 */
			39 01 00 00 00 00 16 E4 2F C3 2F 60 41 C5 C6 CC CC CB 2F CB CA CA C9 C9 C7 C8 2F 41 2F
			/* GIP Pad Setting 2 */
			39 01 00 00 00 00 0D E5 FF FF FF FF FF 13 EF FF FF FF FF 03
			/* Sleep Out */
			05 01 00 00 64 00 01 11
			/* Display On */
			05 01 00 00 00 00 01 29
		];
		qcom,mdss-dsi-off-command = [
			/* Display Off */
			05 01 00 00 64 00 01 28
			/* Sleep In */
			05 01 00 00 78 00 01 10

		];

		qcom,panel-reader-mode-step1-command = [	// LOW 5850K
			39 01 00 00 00 00 11 F5 40 40 40 40 40 40 40 40 00 00 00 00 00 00 00 00
			39 01 00 00 00 00 11 F6 40 40 40 40 40 40 40 40 00 00 00 00 00 00 00 00
			39 01 00 00 00 00 11 F7 34 34 34 34 34 34 34 34 00 00 00 00 00 00 00 00
			15 01 00 00 00 00 02 ED 04
		];
		qcom,panel-reader-mode-step2-command = [	// MIDDLE 5500K
			39 01 00 00 00 00 11 F5 40 40 40 40 40 40 40 40 00 00 00 00 00 00 00 00
			39 01 00 00 00 00 11 F6 40 40 40 40 40 40 40 40 00 00 00 00 00 00 00 00
			39 01 00 00 00 00 11 F7 2F 2F 2F 2F 2F 2F 2F 2F 00 00 00 00 00 00 00 00
			15 01 00 00 00 00 02 ED 04
		];
		qcom,panel-reader-mode-step3-command = [	// HIGH 5350K
			39 01 00 00 00 00 11 F5 3F 3F 3F 3F 3F 3F 3F 3F 00 00 00 00 00 00 00 00
			39 01 00 00 00 00 11 F6 3F 3F 3F 3F 3F 3F 3F 3F 00 00 00 00 00 00 00 00
			39 01 00 00 00 00 11 F7 2D 2D 2D 2D 2D 2D 2D 2D 00 00 00 00 00 00 00 00
			15 01 00 00 00 00 02 ED 04
		];
		qcom,panel-reader-mode-off-command = [		// NORMAL
			15 01 00 00 00 00 02 ED 00
		];
		qcom,mdss-dsi-on-command-state = "dsi_lp_mode";
		qcom,mdss-dsi-off-command-state = "dsi_hs_mode";
		qcom,mdss-dsi-reader-mode-command-state = "dsi_hs_mode";
		qcom,mdss-dsi-h-sync-pulse = <0>;
		qcom,mdss-dsi-traffic-mode = "non_burst_sync_event";
		qcom,mdss-dsi-lane-map = "lane_map_0123";
		qcom,mdss-dsi-bllp-eof-power-mode;
		qcom,mdss-dsi-bllp-power-mode;
		qcom,mdss-dsi-last-line-interleave;
		qcom,mdss-dsi-lane-0-state;
		qcom,mdss-dsi-lane-1-state;
		qcom,mdss-dsi-lane-2-state;
		qcom,mdss-dsi-lane-3-state;
		qcom,mdss-dsi-panel-timings = [8B 1E 14 00 44 4A 18 22 19 03 04 00];
		qcom,mdss-dsi-t-clk-post = <0x04>;
		qcom,mdss-dsi-t-clk-pre = <0x1C>;
		qcom,mdss-dsi-bl-min-level = <1>;
		qcom,mdss-dsi-bl-max-level = <255>;
		qcom,mdss-dsi-dma-trigger = "trigger_sw";
		qcom,mdss-dsi-mdp-trigger = "none";
		qcom,mdss-dsi-reset-sequence = <1 0>, <0 1>, <1 5>;
		qcom,mdss-dsi-panel-status-command = [06 01 00 01 05 00 02 05 00];
		qcom,mdss-dsi-panel-status-command-state = "dsi_hs_mode";

		lge,pre-bl-on-delay = <40>;
		lge,mdss-dsi-extra-command-names = "touch-osc-on", "touch-osc-off";
		lge,mdss-dsi-extra-command-touch-osc-on = [
			15 01 00 00 01 00 02 BF 20
			15 01 00 00 01 00 02 BF 60
		];
		lge,mdss-dsi-extra-command-touch-osc-off = [
			15 01 00 00 01 00 02 BF 20
			15 01 00 00 01 00 02 BF 00
		];
		lge,mdss-dsi-extra-command-state-touch-osc-on = "dsi_lp_mode";
		lge,mdss-dsi-extra-command-state-touch-osc-off = "dsi_lp_mode";

		lge,blmap-size = <256>;
		lge,blmap = <
			0 45 45 45 45 45 45 45 45 45 				/* 0 ~ 9 */
			45 45 45 46 46 47 47 48 48 49				/* 10 ~ 19 */
			49 50 50 51 52 53 54 56 57 58				/* 20 ~ 29 */
			59 61 62 63 64 66 68 70 72 74				/* 30 ~ 39 */
			77 79 81 83 85 88 90 92 94 97				/* 40 ~ 49 */
			101 106 111 116 121 125 130 135 140 145			/* 50 ~ 59 */
			149 153 157 161 166 170 174 178 182 187			/* 60 ~ 69 */
			191 195 199 204 211 218 225 232 239 247			/* 70 ~ 79 */
			254 261 268 275 282 290 297 304 311 319			/* 80 ~ 89 */
			326 333 341 348 355 363 370 377 385 396			/* 90 ~ 99 */
			407 418 429 440 451 462 473 484 495 507			/* 100 ~ 109 */
			517 527 537 547 558 568 578 588 599 609			/* 110 ~ 119 */
			619 629 650 661 672 683 694 705 716 727 		/* 120 ~ 129 */
			738 749 760 771 852 866 880 895 909 923			/* 130 ~ 139 */
			938 952 966 981 995 1010 1026 1042 1058 1074		/* 140 ~ 149 */
			1090 1106 1123 1139 1155 1171 1187 1203 1220 1240	/* 150 ~ 159 */
			1260 1280 1300 1320 1340 1360 1380 1400 1420 1440	/* 160 ~ 169 */
			1460 1479 1498 1517 1536 1556 1575 1594 1613 1633	/* 170 ~ 179 */
			1652 1671 1690 1710 1735 1760 1785 1810 1835 1860	/* 180 ~ 189 */
			1885 1910 1935 1960 1985 2010 2035 2060 2086 2111	/* 190 ~ 199 */
			2136 2162 2187 2213 2238 2263 2289 2314 2340 2370	/* 200 ~ 209 */
			2401 2432 2463 2494 2525 2556 2587 2618 2649 2680	/* 210 ~ 219 */
			2708 2737 2766 2795 2824 2853 2881 2910 2939 2968	/* 220 ~ 229 */
			2997 3026 3055 3089 3123 3157 3191 3225 3260 3294	/* 230 ~ 239 */
			3328 3362 3396 3430 3465 3505 3545 3586 3626 3667	/* 240 ~ 249 */
			3707 3748 3788 3829 3869 3910>;				/* 250 ~ 255 */
	};
};
