&mdss_mdp {
	dsi_tovis_td4100_hd_incell_vid: qcom,mdss_dsi_tovis_incell_td4100_hd_video{
		compatible = "qcom,mdss-dsi-panel";
		status = "disable";
		qcom,cont-splash-enabled;
		qcom,mdss-dsi-panel-name = "TOVIS INCELL TD4100 HD video mode dsi panel";
		qcom,mdss-dsi-panel-controller = <&mdss_dsi0>;
		qcom,mdss-dsi-panel-type = "dsi_video_mode";
		qcom,mdss-dsi-panel-destination = "display_1";
		qcom,mdss-dsi-panel-framerate = <60>;
		qcom,mdss-dsi-force-clock-lane-hs;
		qcom,mdss-dsi-virtual-channel-id = <0>;
		qcom,mdss-dsi-stream = <0>;
		qcom,mdss-dsi-lp11-init;
		qcom,suspend-ulps-enabled;
		qcom,mdss-dsi-panel-width = <720>;
		qcom,mdss-dsi-panel-height = <1280>;
		qcom,mdss-dsi-h-front-porch = <78>;
		qcom,mdss-dsi-h-back-porch = <32>;
		qcom,mdss-dsi-h-pulse-width = <4>;
		qcom,mdss-dsi-h-sync-skew = <0>;
		qcom,mdss-dsi-v-front-porch = <127>;
		qcom,mdss-dsi-v-back-porch = <127>;
		qcom,mdss-dsi-v-pulse-width = <127>;
		qcom,mdss-dsi-h-left-border = <0>;
		qcom,mdss-dsi-h-right-border = <0>;
		qcom,mdss-dsi-v-top-border = <0>;
		qcom,mdss-dsi-v-bottom-border = <0>;
		qcom,mdss-pan-physical-width-dimension = <68>;
		qcom,mdss-pan-physical-height-dimension = <120>;
		qcom,mdss-dsi-bpp = <24>;
		qcom,mdss-dsi-color-order = "rgb_swap_rgb";
		qcom,mdss-dsi-underflow-color = <0>;
		qcom,mdss-dsi-border-color = <0>;
		qcom,mdss-dsi-post-panel-on-command = [
			05 01 00 00 78 00 02
			11 00
			05 01 00 00 00 00 02
			29 00
		];
		qcom,mdss-dsi-off-command = [
			05 01 00 00 50 00 02
			10 00
			05 01 00 00 78 00 02
			28 00
		];

		qcom,panel-reader-mode-step1-command = [
			29 01 00 00 00 00 02    // MACP
			B0 04
			15 01 00 00 00 00 02
			84 3C
			15 01 00 00 00 00 02
			C8 01
			29 01 00 00 00 00 02    // MACP
			B0 03
		];
		qcom,panel-reader-mode-step2-command = [
			29 01 00 00 00 00 02    // MACP
			B0 04
			15 01 00 00 00 00 02
			84 58
			15 01 00 00 00 00 02
			C8 01
			29 01 00 00 00 00 02    // MACP
			B0 03
		];
		qcom,panel-reader-mode-step3-command = [
			29 01 00 00 00 00 02    // MACP
			B0 04
			15 01 00 00 00 00 02
			84 70
			15 01 00 00 00 00 02
			C8 01
			29 01 00 00 00 00 02    // MACP
			B0 03
		];
		qcom,panel-reader-mode-off-command = [
			29 01 00 00 00 00 02    // MACP
			B0 04
			15 01 00 00 00 00 02
			84 00
			15 01 00 00 00 00 02
			C8 00
			29 01 00 00 00 00 02    // MACP
			B0 03
		];

		qcom,mdss-dsi-on-command-state = "dsi_lp_mode";
		qcom,mdss-dsi-off-command-state = "dsi_hs_mode";
		qcom,mdss-dsi-reader-mode-command-state = "dsi_hs_mode";
		qcom,mdss-dsi-h-sync-pulse = <0>;
		qcom,mdss-dsi-traffic-mode = "non_burst_sync_event";
		qcom,mdss-dsi-lane-map = "lane_map_0123";
		qcom,mdss-dsi-bllp-eof-power-mode;
		qcom,mdss-dsi-bllp-power-mode;
		qcom,mdss-dsi-lane-0-state;
		qcom,mdss-dsi-lane-1-state;
		qcom,mdss-dsi-lane-2-state;
		qcom,mdss-dsi-lane-3-state;
		qcom,mdss-dsi-tx-eot-append;
		qcom,mdss-dsi-panel-timings = [8B 1E 14 00 44 4A 18 22 19 03 04 00];
		qcom,mdss-dsi-t-clk-post = <0x04>;
		qcom,mdss-dsi-t-clk-pre = <0x1C>;

		//The following feature "none" and "trigger_sw" are the same in video mode.
		//The feature used any option of TE signal in command mode.
		qcom,mdss-dsi-dma-trigger = "trigger_sw";	//default "trigger_sw"
		qcom,mdss-dsi-mdp-trigger = "trigger_sw";	//default "trigger_sw"

		qcom,mdss-dsi-bl-min-level = <1>;
		qcom,mdss-dsi-bl-max-level = <255>;
		qcom,mdss-dsi-bl-pmic-control-type = "bl_ctrl_wled";
		qcom,mdss-dsi-reset-sequence = <0 10>, <1 200>;

		lge,blmap-size = <256>;
		lge,blmap = <
			0 25 26 27 28 29 30 31 32 33				/* 0 ~ 9 */
			38 38 38 38 39 39 39 39 40 40				/* 10 ~ 19 */
			40 40 41 41 42 43 44 45 46 47				/* 20 ~ 29 */
			48 49 50 51 52 55 57 57 60 63				/* 30 ~ 39 */
			65 67 70 73 75 78 80 80 85 90				/* 40 ~ 49 */
			90 95 95 100 105 105 110 115 115 120			/* 50 ~ 59 */
			125 130 135 140 145 150 155 160 165 170			/* 60 ~ 69 */
			175 175 180 185 190 195 200 205 210 215			/* 70 ~ 79 */
			220 230 235 240 250 255 260 265 270 275			/* 80 ~ 89 */
			280 285 290 295 300 310 320 330 340 345			/* 90 ~ 99 */
			350 360 370 380 390 400 410 415 420 430			/* 100 ~ 109 */
			440 450 460 470 480 490 500 510 520 530			/* 110 ~ 119 */
			535 540 555 567 579 593 615 637 651 667			/* 120 ~ 129 */
			673 679 680 680 692 703 714 725 738 750			/* 130 ~ 139 */
			768 782 795 803 810 820 835 850 865 880			/* 140 ~ 149 */
			895 910 925 940 955 970 985 995 1011 1027		/* 150 ~ 159 */
			1043 1059 1075 1091 1107 1123 1139 1155 1171 1187	/* 160 ~ 169 */
			1200 1217 1234 1250 1300 1350 1400 1450 1455 1460	/* 170 ~ 179 */
			1462 1466 1500 1502 1506 1508 1510 1520 1526 1547	/* 180 ~ 189 */
			1568 1589 1610 1631 1635 1659 1683 1707 1731 1755	/* 190 ~ 199 */
			1779 1803 1827 1851 1875 1899 1900 1922 1944 1966	/* 200 ~ 209 */
			1988 2010 2032 2054 2076 2098 2120 2142 2164 2180	/* 210 ~ 219 */
			2205 2230 2255 2280 2305 2330 2355 2380 2405 2430	/* 220 ~ 229 */
			2455 2480 2507 2534 2561 2588 2615 2642 2669 2696	/* 230 ~ 239 */
			2723 2750 2777 2800 2830 2860 2890 2920 2950 2980	/* 240 ~ 249 */
			3010 3050 3150 3250 3300 3350				/* 250 ~ 255 */
		>;

	};
};
