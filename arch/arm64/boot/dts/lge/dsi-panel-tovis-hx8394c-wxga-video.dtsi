/* Copyright (c) 2013, The Linux Foundation. All rights reserved.
 *
 * This program is free software; you can redistribute it and/or modify
 * it under the terms of the GNU General Public License version 2 and
 * only version 2 as published by the Free Software Foundation.
 *
 * This program is distributed in the hope that it will be useful,
 * but WITHOUT ANY WARRANTY; without even the implied warranty of
 * MERCHANTABILITY or FITNESS FOR A PARTICULAR PURPOSE.  See the
 * GNU General Public License for more details.
 */

/*---------------------------------------------------------------------------
 * This file is autogenerated file using gcdb parser. Please do not edit it.
 * Update input XML file to add a new entry or update variable in this file
 * VERSION = "1.0"
 *---------------------------------------------------------------------------*/
&mdss_mdp {
	dsi_tovis_hx8394c_wxga_video: qcom,mdss_dsi_tovis_hx8394c_wxga_video {
		compatible = "qcom,mdss-dsi-panel";
		status = "ok";
		qcom,cont-splash-enabled;
		qcom,mdss-dsi-panel-name = "tovis hx8394c wxga video mode dsi panel";
		qcom,mdss-dsi-panel-controller = <&mdss_dsi0>;
		qcom,mdss-dsi-panel-type = "dsi_video_mode";
		qcom,mdss-dsi-panel-destination = "display_1";
		qcom,mdss-dsi-panel-framerate = <60>;
		qcom,mdss-pan-physical-width-dimension = <108>;
		qcom,mdss-pan-physical-height-dimension = <172>;
		qcom,mdss-dsi-virtual-channel-id = <0>;
		qcom,mdss-dsi-stream = <0>;
		qcom,mdss-dsi-panel-width = <800>;
		qcom,mdss-dsi-panel-height = <1280>;
		qcom,mdss-dsi-h-front-porch = <16>;
		qcom,mdss-dsi-h-back-porch = <48>;
		qcom,mdss-dsi-h-pulse-width = <16>;
		qcom,mdss-dsi-h-sync-skew = <0>;
		qcom,mdss-dsi-v-front-porch = <8>;
		qcom,mdss-dsi-v-back-porch = <4>;
		qcom,mdss-dsi-v-pulse-width = <4>;
		qcom,mdss-dsi-h-left-border = <0>;
		qcom,mdss-dsi-h-right-border = <0>;
		qcom,mdss-dsi-v-top-border = <0>;
		qcom,mdss-dsi-v-bottom-border = <0>;
		qcom,mdss-dsi-bpp = <24>;
		qcom,mdss-dsi-color-order = "rgb_swap_rgb";
		qcom,mdss-dsi-underflow-color = <0xff>;
		qcom,mdss-dsi-border-color = <0>;

		qcom,mdss-dsi-on-command = [
			39 01 00 00 00 00 04
			B9 FF 83 94
			39 01 00 00 00 00 04
			C3 83 94 0C
			39 01 00 00 00 00 2D
			D5 03 02 03 02 01 00 01 00 07 06 07 06 05 04 05 04 21 20 18 18 18 18 18 18 18 18 18 18 18 18 23 22 18 18 18 18 18 18 18 18 18 18 18 18
			39 01 00 00 00 00 2D
			D6 04 05 04 05 06 07 06 07 00 01 00 01 02 03 02 03 22 23 18 18 18 18 18 18 18 18 18 18 18 18 20 21 18 18 18 18 18 18 18 18 18 18 18 18
			39 01 00 00 00 00 03
			BA 23 42
			39 01 00 00 00 00 26
			D3 00 05 00 01 07 18 00 32 10 02 00 02 32 15 0B 05 0B 00 00 00 00 00 47 03 04 04 47 00 00 00 0C 00 00 00 0A 00 01
			39 01 00 00 00 00 2B
			E0 02 10 10 2C 30 39 1A 38 07 0B 0C 17 0F 11 15 11 13 07 12 13 18 02 10 10 2C 30 39 1A 38 07 0B 0C 17 0F 11 15 11 13 07 12 13 18

			/* CAUTION !!! : if need to change, also check reader-mode-off-cmds */
			39 01 00 00 00 00 02
			BD 02
			39 01 00 00 00 00 2B
			C1 00 08 10 18 20 28 30 38 40 48 50 58 60 68 70 78 82 88 90 98 A0 A8 B0 B8 C0 C8 D0 D8 E0 E8 F0 F8 FF 0A A9 AA AE 55 BA DC 8C C0
			39 01 00 00 00 00 02
			BD 01
			39 01 00 00 00 00 2B
			C1 00 08 10 18 20 28 30 37 3F 47 4E 56 5D 64 6C 76 7D 86 8D 95 9C A5 AC B4 BB C4 CB D4 DB E4 EB F4 FB 06 AA A8 09 F2 B4 C9 45 C0
			39 01 00 00 00 00 02
			BD 00
			39 01 00 00 00 00 2C
			C1 01 00 08 10 18 20 28 30 37 40 48 50 57 5F 67 70 78 80 88 90 98 A0 A8 B0 B8 C0 C8 D0 D8 E0 E8 F0 F8 FF 15 AA A8 0A A7 97 48 66 40

			39 01 00 00 00 00 10
			B1 6C 10 10 44 04 11 F1 81 69 DA 23 80 C0 D2 58
			39 01 00 00 00 00 10
			B2 45 64 14 09 20 1C 08 08 1C 4D 00 00 30 44 24
			39 01 00 00 00 00 17
			B4 00 FD 5C 56 48 4A 58 59 01 68 02 67 5C 56 5C 56 5C 56 01 68 01 68
			39 01 00 00 00 00 02
			CC 09
			39 01 00 00 00 00 02
			BC 07
			39 01 00 00 00 00 03
			C0 30 11
			39 01 00 00 00 00 04
			C7 00 00 20
			39 01 00 00 00 00 06
			C9 1F 2E 1E 1E 10
			39 01 00 00 00 00 03
			E4 00 01

			05 01 00 00 8C 00 01
			11
			05 01 00 00 05 00 01
			29
			];
		qcom,mdss-dsi-off-command = [
			05 01 00 00 05 00 01
			28
			05 01 00 00 64 00 01
			10
			];

		qcom,mdss-dsi-on-command-state = "dsi_lp_mode";
		qcom,mdss-dsi-off-command-state = "dsi_hs_mode";
		qcom,mdss-dsi-reader-mode-command-state = "dsi_hs_mode";
		qcom,mdss-dsi-h-sync-pulse = <0>;
//		qcom,mdss-dsi-traffic-mode = "non_burst_sync_event";
		qcom,mdss-dsi-lane-map = "lane_map_0123";
		qcom,mdss-dsi-bllp-eof-power-mode;
		qcom,mdss-dsi-bllp-power-mode;
		qcom,mdss-dsi-lane-0-state;
		qcom,mdss-dsi-lane-1-state;
		qcom,mdss-dsi-lane-2-state;
		qcom,mdss-dsi-lane-3-state;
		qcom,mdss-dsi-lp11-init = <1>;
		qcom,mdss-dsi-panel-timings = [7B 1A 10 00 3C 42 14 1c 15 03 04 00];
		qcom,mdss-dsi-t-clk-post = <0x04>;
		qcom,mdss-dsi-t-clk-pre = <0x1A>;
		qcom,mdss-dsi-dma-trigger = "trigger_sw";
		qcom,mdss-dsi-mdp-trigger = "none";
		qcom,mdss-dsi-reset-sequence = <1 15>, <0 1>, <1 50>;

		/* reader mode 1 - 6200k */
		qcom,panel-reader-mode-step1-command = [
			39 01 00 00 00 00 02
			BD 02
			39 01 00 00 00 00 2B
			C1 00 07 0E 15 1C 24 2B 33 3B 41 49 50 57 5E 66 70 7A 7F 84 8C 95 9D A5 AC B5 BD C4 CC D3 DB E3 EA F1 16 E9 C6 4A 2C 63 8A D6 C0
			39 01 00 00 00 00 02
			BD 01
			39 01 00 00 00 00 2B
			C1 00 07 0E 15 1C 23 2A 32 3A 3F 46 4D 54 5A 61 69 73 7C 80 86 8C 95 9C A3 AA B3 B9 C0 C8 CF D6 DD E5 06 B8 3F 6F C0 CE CD 40 00
			39 01 00 00 00 00 02
			BD 00
			39 01 00 00 00 00 2C
			C1 01 00 08 10 18 21 28 30 39 3F 48 50 57 5E 67 72 7B 80 86 8E 98 A0 A8 B1 B8 BF C8 D0 D7 E0 E7 F0 F8 FF 1B 1A D5 A7 69 82 F7 30 C0
		];

		/* reader mode 2 - 5500k */
		qcom,panel-reader-mode-step2-command = [
			39 01 00 00 00 00 02
			BD 02
			39 01 00 00 00 00 2B
			C1 00 06 0C 13 19 21 27 2E 35 3D 42 49 50 56 5C 63 6B 75 7D 80 87 8D 96 9D A4 AB B3 BA C0 C8 CF D6 DC 2D D9 A2 45 97 32 69 F5 80
			39 01 00 00 00 00 02
			BD 01
			39 01 00 00 00 00 2B
			C1 00 07 0D 14 1B 22 29 30 37 3F 44 4B 51 57 5E 65 6D 77 7E 82 88 8F 97 9E A5 AC B3 BA C0 C8 CF D6 DC 0E 66 C1 F3 EC 69 0E E0 80
			39 01 00 00 00 00 02
			BD 00
			39 01 00 00 00 00 2C
			C1 01 00 08 10 18 21 28 30 39 3F 48 50 57 5E 67 72 7B 80 87 8F 98 A0 A8 B1 B8 C0 C8 D0 D8 E0 E8 F0 F8 FF 1B 29 E5 97 42 83 34 00 C0
		];

		/* reader mode 3 - 5000k */
		qcom,panel-reader-mode-step3-command = [
			39 01 00 00 00 00 02
			BD 02
			39 01 00 00 00 00 2B
			C1 00 06 0B 11 17 1E 24 2A 31 38 3F 43 4A 50 55 5B 62 69 72 7A 7F 83 89 90 98 9E A4 AB B3 B9 BF C6 CC 0F DB 50 1E 29 42 19 14 C0
			39 01 00 00 00 00 02
			BD 01
			39 01 00 00 00 00 2B
			C1 00 06 0C 13 19 20 26 2C 33 3A 3F 46 4C 52 58 5E 64 6C 75 7C 80 85 8B 92 99 A0 A6 AD B4 BA C0 C7 CE 2C A7 7C 50 EB 12 E4 A6 00
			39 01 00 00 00 00 02
			BD 00
			39 01 00 00 00 00 2C
			C1 01 00 08 10 18 21 28 30 39 3F 48 4F 57 5E 67 72 7B 80 87 8F 98 9F A8 B1 B8 C0 C8 D0 D8 E0 E8 F0 F8 FF 1B 1E DC 53 55 C3 35 01 C0
		];

		/* reader mode off */
		qcom,panel-reader-mode-off-command = [
			39 01 00 00 00 00 02
			BD 02
			39 01 00 00 00 00 2B
			C1 00 08 10 18 20 28 30 38 40 48 50 58 60 68 70 78 82 88 90 98 A0 A8 B0 B8 C0 C8 D0 D8 E0 E8 F0 F8 FF 0A A9 AA AE 55 BA DC 8C C0
			39 01 00 00 00 00 02
			BD 01
			39 01 00 00 00 00 2B
			C1 00 08 10 18 20 28 30 37 3F 47 4E 56 5D 64 6C 76 7D 86 8D 95 9C A5 AC B4 BB C4 CB D4 DB E4 EB F4 FB 06 AA A8 09 F2 B4 C9 45 C0
			39 01 00 00 00 00 02
			BD 00
			39 01 00 00 00 00 2C
			C1 01 00 08 10 18 20 28 30 37 40 48 50 57 5F 67 70 78 80 88 90 98 A0 A8 B0 B8 C0 C8 D0 D8 E0 E8 F0 F8 FF 15 AA A8 0A A7 97 48 66 40
		];

		lge,blmap-size = <256>;
		lge,blmap = <
			0	50	50	50	50	50	50	50	50	50		/* 0 ~ 9 */
			50	51	52	53	54	55	56	57	58	59		/* 10 ~ 19 */
			60	61	62	63	63	64	65	66	67	68		/* 20 ~ 29 */
			69	70	71	72	73	74	75	79	83	87		/* 30 ~ 39 */
			91	95	99	103 107 111 115 119 123 126 	/* 40 ~ 49 */
			130 134 138 142 146 150 154 158 162 166 	/* 50 ~ 59 */
			170 174 178 181 185 189 193 196 200 204 	/* 60 ~ 69 */
			208 211 215 219 223 226 230 234 238 241 	/* 70 ~ 79 */
			245 249 253 256 260 272 284 296 308 320 	/* 80 ~ 89 */
			332 343 355 367 379 391 403 415 427 439 	/* 90 ~ 99 */
			451 463 475 487 498 510 522 534 546 558 	/* 100 ~ 109 */
			570 584 598 611 625 639 653 666 680 694 	/* 110 ~ 119 */
			708 721 735 749 763 776 790 804 818 831 	/* 120 ~ 129 */
			845 859 873 886 900 918 937 955 973 992 	/* 130 ~ 139 */
			1010	1028	1047	1065	1083	1102	1120	1138	1157	1175		/* 140 ~ 149 */
			1193	1212	1230	1248	1267	1285	1303	1322	1340	1362		/* 150 ~ 159 */
			1383	1405	1427	1448	1470	1492	1513	1535	1557	1578		/* 160 ~ 169 */
			1600	1623	1645	1668	1690	1713	1735	1758	1780	1803		/* 170 ~ 179 */
			1825	1848	1870	1896	1923	1949	1975	2001	2028	2054		/* 180 ~ 189 */
			2080	2106	2133	2159	2185	2211	2238	2264	2290	2316		/* 190 ~ 199 */
			2343	2369	2395	2421	2448	2474	2500	2529	2558	2587		/* 200 ~ 209 */
			2615	2644	2673	2702	2731	2760	2788	2817	2846	2875		/* 210 ~ 219 */
			2904	2933	2962	2990	3019	3048	3077	3106	3135	3163		/* 220 ~ 229 */
			3192	3221	3250	3287	3323	3360	3397	3434	3470	3507		/* 230 ~ 239 */
			3544	3581	3617	3654	3691	3728	3764	3801	3838	3875		/* 240 ~ 249 */
			3911	3948	3985	4022	4058	4095						/* 250 ~ 255 */
		>;
	};
};
